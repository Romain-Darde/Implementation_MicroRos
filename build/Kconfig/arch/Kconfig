## build/Kconfig/arch/Kconfig
```kconfig
# Load arch Kconfig descriptions.
osource "/home/romain/zephyrproject/zephyr/arch/x86/Kconfig"
osource "/home/romain/zephyrproject/zephyr/arch/xtensa/Kconfig"
osource "/home/romain/zephyrproject/zephyr/arch/sparc/Kconfig"
osource "/home/romain/zephyrproject/zephyr/arch/riscv/Kconfig"
osource "/home/romain/zephyrproject/zephyr/arch/posix/Kconfig"
osource "/home/romain/zephyrproject/zephyr/arch/nios2/Kconfig"
osource "/home/romain/zephyrproject/zephyr/arch/mips/Kconfig"
osource "/home/romain/zephyrproject/zephyr/arch/arm64/Kconfig"
osource "/home/romain/zephyrproject/zephyr/arch/arm/Kconfig"
osource "/home/romain/zephyrproject/zephyr/arch/arc/Kconfig"
```
